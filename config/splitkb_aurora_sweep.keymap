/* source keypos definitions */
#include "zmk-helpers/key-labels/34.h"

/* activate bluetooth */
#define CONFIG_WIRELESS

/* activate gaming layers */
#define CONFIG_GAMING

/* Use alt-codes for unicode on Win+Mac */
#define HOST_OS 2

/* source the main keymap */
#include "base.keymap"

/* Local Variables: */
/* mode: c */
/* End: */
/* vim: set ft=c tw=174: */
