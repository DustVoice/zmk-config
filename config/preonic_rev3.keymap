/* source keypos definitions */
#include "zmk-helpers/key-labels/preonic.h"

/* map Preonic's extra keys */
#define X_LN  &none &none  &none  &none  &none  &none  // number row, left
#define X_RN  &none &none  &none  &none  &none  &none  // number row, right

#define X_LT  &none                          // top row, left
#define X_RT  &none                          // top row, right

#define X_LM  &none                          // middle row, left
#define X_RM  &none                          // middle row, right

#define X_LB  &none                          // bottom row, left
#define X_RB  &none                          // bottom row, right

// NOTE: Not in use
// #define X_LH  &none &none  &kp LGUI &smart_mouse // thumb row, left
#define X_LH  &none &none  &kp LGUI &none // thumb row, left
#define X_RH  &bs_del   U_WH_D   U_WH_U   &none  // thumb row, right

/* source the main keymap */
#include "base.keymap"

/* Local Variables: */
/* mode: c */
/* End: */
/* vim: set ft=c tw=174: */
