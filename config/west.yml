## config/west.yml
```yaml
manifest:
  remotes:
    - name: zmkfirmware
      url-base: https://github.com/zmkfirmware
    - name: urob
      url-base: https://github.com/urob
    - name: dustvoice
      url-base: https://github.com/dustvoice
  projects:
    - name: zmk
      remote: urob
      revision: going-modular
      import: app/west.yml
    - name: zmk-helpers
      remote: dustvoice
      revision: main
    - name: zmk-auto-layer
      remote: urob
      revision: main
    - name: zmk-tri-state
      remote: urob
      revision: main
  self:
    path: config
```
