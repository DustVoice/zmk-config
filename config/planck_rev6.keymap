#define ZMK_BASE_LAYER(name, LT, RT, LM, RM, LB, RB, LH, RH)                   \
    ZMK_LAYER(                                                                 \
        name,                                                                  \
                             LT &none &none RT                                 \
                             LM &none &none RM                                 \
                             LB &none &none RB                                 \
        &none &none &kp LGUI LH &none &none RH &smart_mouse U_WH_D U_WH_U      \
    )

#include "zmk-helpers/key-labels/4x12_wide.h"

/* map Planck's extra keys */
#define X_MT  &none &none                // top row, middle
#define X_MM  &none &none                // middle row, middle
#define X_MB  &none &none                // bottom row, middle
#define X_LH  &none &none &kp LGUI       // thumb row, left
#define X_MH  &none &none                // thumb row, middle
// NOTE: Not in use
// #define X_RH  &smart_mouse U_WH_D U_WH_U // thumb row, right
#define X_RH  &none U_WH_D U_WH_U // thumb row, right

/* source the main keymap */
#include "base.keymap"

/* Local Variables: */
/* mode: c */
/* End: */
/* vim: set ft=c tw=174: */
