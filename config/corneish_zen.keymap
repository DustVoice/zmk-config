#define CONFIG_WIRELESS
#define ZMK_BASE_LAYER(name, LT, RT, LM, RM, LB, RB, LH, RH)                   \
    ZMK_LAYER(                                                                 \
        name,                                                                  \
                 LT RT                                                         \
                 LM RM                                                         \
                 LB RB                                                         \
        &kp LGUI LH RH &smart_mouse                                            \
    )

#include "zmk-helpers/key-labels/36.h"

/* map Zen's extra keys */
#define X_LH  &kp LGUI      // thumb row, left
// NOTE: Not in use
// #define X_RH  &smart_mouse  // thumb row, right
#define X_RH  &none  // thumb row, right

/* activate bluetooth */
#define CONFIG_WIRELESS

/* source the main keymap */
#include "base.keymap"

/* use 5-column layout for Zen */
ZMK_APPLY_MATRIX_TRANSFORM(five_column_transform)

/* Local Variables: */
/* mode: c */
/* End: */
/* vim: set ft=c tw=174: */
/{ chosen { zmk,physical-layout = &foostan_corne_5col_layout; }; };
